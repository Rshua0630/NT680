/*
 * dts file for Novatek NT72671 FPGA
 *
 * Copyright (C) 2014, Novatek Microelectronics Corp.
 *
 * This program is free software; you can redistribute it and/or
 * modify it under the terms of the GNU General Public License as
 * published by the Free Software Foundation; either version 2 of
 * the License, or (at your option) any later version.
 */

/dts-v1/;

/include/ "nt72671.dtsi"

/ {
	model = "Novatek NT72671 FPGA";
	compatible = "novatek,nt72671";

	chosen {
		bootargs = "console=ttyS0,57600 rdinit=/sbin/init";
	};

	memory {
		device_type = "memory";
		reg = <0x01000000 0x0f000000>;
	};
};
