## linux-kernel/Documentation/devicetree/bindings/arm/nvt-172.txt
```
Novatek 172 processor define
-----------------------------------------------------
This binding defines the location of the bounce buffer
used for non-secure to secure communications.

Required properties:
- compatible : "novatek,nt72172", "nvt,ca53";
- reg :        register space
```

## linux-kernel/Documentation/devicetree/bindings/cpufreq/cpufreq-nvt72172.txt
```
Novatek cpufreq driver
-------------------

novatek SoC cpufreq driver for CPU frequency scaling.
It supports both uniprocessor (UP) and symmetric multiprocessor (SMP) systems
which share clock across all CPUs.

Required properties:
- compatible : "nvt,nvt72xxx-cpufreq";
- reg :        register space

Both required and optional properties listed above must be defined under node
/cpus/cpu@0.

Examples:
--------
        nvt-cpufreq {
                compatible = "nvt,nvt72xxx-cpufreq";
                operating-points = <
                        /* KHz    uV , voltage is fake*/
                        1000000 1000000
                        800000  1000000
                        500000  1000000
                        /* 100000  1000000 */
                >;
        };
```

## linux-kernel/Documentation/devicetree/bindings/i2c/i2c-nvt.txt
```
i2c Controller on nvt platform:

Required properties:
- compatible : "nvt,nt726xx_i2c.0";
- compatible : "nvt,nt726xx_i2c.1";
- compatible : "nvt,nt726xx_i2c.2";
- compatible : "nvt,nt726xx_i2c.3";
- compatible : "nvt,nt726xx_i2c.4";
- compatible : "nvt,nt726xx_i2c.5";
- compatible : "nvt,nt726xx_i2c.6";
- compatible : "nvt,nt726xx_i2c.7";
```

## linux-kernel/Documentation/devicetree/bindings/misc/nvt-ahb-clk.txt
```
Novatek ahb clk driver
-------------------

novatek SoC ahb clk driver for CPU frequency scaling.

Required properties:
- compatible : "nvt,ahb_clk";
- reg :        register space

Examples:
--------
        ahb_clk: ahb_clk {
                        compatible = "nvt,ahb_clk";
                        #clock-cells = <0>;
                        clock-output-names = "ahb_clk";
        };
```

## linux-kernel/Documentation/devicetree/bindings/misc/nvt-atf.txt
```
Novatek atf driver
-------------------

novatek SoC atf driver

Required properties:
- compatible : "nvt,art";
- reg :        register space

Examples:
        atf@0xfd060100 {
                compatible = "nvt,atf";
                interrupts = <0 140 4>;
                reg = <0xfd060100 0xc0>;
        };
```

## linux-kernel/Documentation/devicetree/bindings/misc/nvt-clk.txt
```
Novatek clk driver
-------------------

novatek SoC clk driver

Required properties:
- compatible : "nvt,clkgen";
- reg :        register space

Examples:
        clk_gen {
                compatible = "nvt,clkgen";
                reg = <0xfd020000 0x400>,
                          <0xfd670000 0x1000>,
                          <0xfd720000 0x400>,
                          <0xfd0f0c18 0x4>;
        };
```

## linux-kernel/Documentation/devicetree/bindings/misc/nvt-periph-clk.txt
```
Novatek periphal clk driver
-------------------

novatek SoC periphal clk driver for CPU frequency scaling.

Required properties:
- compatible : "nvt,periph_clk";
- reg :        register space

Examples:
--------
        periph_clk: periph_clk {
                        compatible = "nvt,periph_clk";
                        #clock-cells = <0>;
                        clock-output-names = "periph_clk";
        };
```

## linux-kernel/Documentation/devicetree/bindings/misc/nvt-reset.txt
```
Novatek reset driver
-------------------

novatek SoC reset driver

Required properties:
- compatible : "nvt,nvtsoc-reset";
- compatible : "nvt,nvtsoc-shutdown";
- compatible : "nvt,nvtsoc-reboot";


Examples:
        reset@0 {
	                compatible = "nvt,nvtsoc-reset";
	        };

        shutdown@0 {
	                compatible = "nvt,nvtsoc-shutdown";
	        };

        reboot@0 {
	                compatible = "nvt,nvtsoc-reboot";
	        };
```

## linux-kernel/Documentation/devicetree/bindings/misc/nvt-rtc.txt
```
Novatek rtc driver
-------------------

novatek SoC rtc driver

Required properties:
- compatible : "novatek,nvtsoc-rtc";

Examples:
        nvtsoc-rtc {
                compatible = "novatek,nvtsoc-rtc";
        };
```

## linux-kernel/Documentation/devicetree/bindings/misc/nvt-stbc.txt
```
Novatek stbc driver
-------------------

novatek SoC stbc driver

Required properties:
- compatible : "novatek,nvt-stbc";
- reg :        register space

Examples:
        clk_gen {
                compatible = "novatek,nvt-stbc";
		reg = <0xfc040000 0x288>;
		download_reg_ofs = <0x0>;
		upload_reg_ofs = <0x4>;
		int_stat_reg_ofs = <0x8>;
		stbc_patt_reg_ofs = <0x204>;
		stbc_key_pass_reg_ofs = <0x208>;
		rtc_base_reg_ofs = <0x100>;
		rtc_sec_reg_ofs = <0x104>;
		rtc_day_reg_ofs = <0x108>;
		rtc_ctrl_reg_ofs = <0x114>;
		rtc_switch_reg_ofs = <0x200>;
		bootstrap_reg_ofs = <0x210>;
        };
```

## linux-kernel/Documentation/devicetree/bindings/misc/nvt-unzip.txt
```
Novatek unzip engine
-----------------------------------------------------
This binding defines the location of the bounce buffer
used for non-secure to secure communications.

Required properties:
- compatible : "nvt,unzip"
- reg :	register space

Example:
	unzip@0xfd6f0000 {
		compatible = "nvt,unzip";
		compatible = "novatek,nvt-unzip";
		compatible = "novatek,nvt-unzip-misc";
		interrupts = <0 97 4>;
		reg = <0xfd6f0000 0x40>;
	};
```

## linux-kernel/Documentation/devicetree/bindings/mmc/sdhci-nvt.txt
```
* Novatek's SDHCI Controller device tree bindings

Novatek's SDHCI controller is used as a connectivity interface with external
MMC, SD and eMMC storage mediums. This file documents differences between the
core mmc properties described by mmc.txt and the properties used by the
Novatek implementation of the SDHCI controller.

Required SoC Specific Properties:
- compatible: should be one of the following
  - "nvt,hsmmc": For controllers compatible with Novatek TV sdhci
    controller.


Example:

	nfc@0xfc048000 {
		compatible = "nvt,nfc";
		//    NFC
		reg = <0xfc048000 0x200>;
		interrupts = <0 63 4>;
	};

	mmc@0xfc048300 {
		compatible = "nvt,hsmmc";
		//    SDC                 NFC                 FCR
		reg = <0xfc048300 0x100>, <0xfc048000 0x200>, <0xfc048200 0x100>;
		interrupts = <0 63 4>;
		max-bus-frequency = <180000000>;
	};

	Note: This example shows both SoC specific and board specific properties
	in a single device node. The properties can be actually be separated
	into SoC specific node and board specific node.
```

## linux-kernel/Documentation/devicetree/bindings/net/nvt_synopgmac.txt
```
* novatek synopGMAC and NVT Internal Phy

Required properties:
- compatible: "nvt,synopsys-mac".
- reg: address and length of the register set for the device.
- interrupts: interrupt for the device

Example:
ethernet@fd160000 {
	compatible = "nvt,synopsys-mac";
	//MAC & DMA & GPIO mux & Clock pad-in mux & Clock control
	reg = <0xfd160000 0x0ffc>,
		  <0xfd161000 0x0054>,
		  <0xfd100400 0x4>,
		  <0xfc040bf0 0x4>,
		  <0xfc040bf4 0x4>;
	interrupts = <0 42 4>;
};
```

## linux-kernel/Documentation/devicetree/bindings/usb/ehci-nvt.txt
```
ehci@fc1f0000 {
	compatible = "nvt,NT72668-ehci";
	//    AHB
	reg = <0xfc1f0000 0x200>;
	interrupts = <0 76 4>;
	id = <0>;
	usb2phy = <&u2phy_1>;
};
```

## linux-kernel/Documentation/devicetree/bindings/usb/phy-nvt-u2.txt
```
u2phy_1: nvt_usb2_phy@fd170000 {
	compatible = "nvt,NT72668-usb2phy";
	//    APB                 PONRST APB		PHY
	reg = <0xfd170000 0x500>, <0xfd170000 0x500>,
			<0xfd170400 0x500>;
	//offset mask value
	nvt,phy_setting = <0x18 0xe 0x0>,  //TX parameter
										<0x18 0xc 0xc>,  //TX parameter
										<0xdc 0x20 0x0>, //timing parameter
										<0x14 0x3 0x3>;  //dis parameter
	nvt,phy_group = <0>;
};
```

## linux-kernel/arch/arm/mach-nvt-na51000/Kconfig
```kconfig
config MACH_NVT_NA51000
	bool "Novatek NA51000 series SOC support" if ARCH_NVT_IVOT_V7
	select GENERIC_ALLOCATOR
	select ARCH_REQUIRE_GPIOLIB
	select CLKDEV_LOOKUP
	select COMMON_CLK
	select GENERIC_IRQ_CHIP
	select MULTI_IRQ_HANDLER
	select HAVE_SMP
	select NVT_IPC
	help
	  Support for Novatek's video processing platform.

choice
	prompt "Board type"
	default NT96680_FPGA_EMULATION_S1

config NVT_NT9668X_EVB
	bool "NT9668X EVB board"
	depends on MACH_NVT_NA51000
	help
	  Enable this option to do NT9668X EVB.
endchoice

config NVT_IM_UART
	bool "NVT IM 8250 compatible UART"
	depends on MACH_NVT_NA51000
	default y
	help
	  This option will configure the NVT IM UART HW setting.

config NVT_INFO
	bool "NVT IVOT info for time measurement/memory hotplug/modelext...etc functions."
	depends on MACH_NVT_NA51000
	default y
	help
	  Support NVT multi-functions such as boot time measurement/memory hotplug/modelext...etc.
	  We provide a tool can be used to measure booting time. ($ cat /proc/nvt_info/bootts)

config NVT_WIFI_BRCM_WOW
	bool "To support Broadcom AP6212a driver WOW mode."
	depends on MACH_NVT_NA51000
	default n
	help
	  Enable this option can let ap6212a wifi module support WOW mode.
	  The WOW mode is to keep alive after system goes to sleep/suspend.
	  Please also enable Wifi function in ModelConfig_XXX.txt

config NVT_WIFI_BRCM_PM
	bool "To support Broadcom AP6212a driver PM mode."
	depends on MACH_NVT_NA51000
	default n
	help
	  Enable this option can let ap6212a wifi module support Suspend to RAM(STR) mode.
	  Please also enable Wifi function in ModelConfig_XXX.txt

config NVT_VOS
	bool "NVT_VOS"
	depends on MACH_NVT_NA51000 && SMP
	default n
	help
	  This option will configure the nvt_vos the runs uItron on Linux.	  
```

## linux-kernel/arch/arm/mach-nvt72xxx/Kconfig
```kconfig
choice
	prompt "Novatek board selection"
	depends on ARCH_NVT_V7
	default ARCH_NVT72658

config ARCH_NVT72668
	bool "Novatek NVT72668 SoC (Cotex A9x4)"
	help
	  This option enables support for systems using Cortex processor based
	  Novatek Cortex A9X4 72668 motherboard,
	  for example:

	  - Cortex-A9x4

	  You must boot using a Flattened Device Tree in order to use these
	  platforms. The traditional (ATAGs) boot method is not usable on
	  these boards with this option.

config ARCH_NVT72658
	bool "Novatek NVT72658 SoC (Cotex A9x2)"
	help
	  This option enables support for systems using Cortex processor based
	  Novatek Cortex A9x2 72658 motherboard,

endchoice
```

## linux-kernel/arch/arm64/Kconfig.nvt
```kconfig
#we put NVT related arch config here
#menuconfig NVT
if ARCH_NVT_V8
config ARCH_NVT72172
	bool "Novatek NVT72172"
        ---help---
	  This config is use to enable 172 related features
	  Driver owner can use it for 172 IPs flow determination

	  default it will be selected by ARCH_NVT_V8
	  and will be select for NT72172 plaotform

config ARCH_NVT_FPGA
	bool "ARMv8 novatek fpga platform"
	help
	  This enables support for the ARMv8 on novatek platform
endif # NVT
```

## linux-kernel/drivers/mtd/spiflash/Kconfig
```kconfig
config MTD_SPINAND
	tristate "SPINAND Device Support for Micron/winbond"
	depends on (NVT_NT96660 || MACH_NVT_NA51000) && MTD_NAND
	help
	  This enables support for accessing Micron/winbond SPI NAND flash
	  devices.
	  If you have Micron/winbond SPI NAND chip say yes.

	  If unsure, say no here.

config MTD_SPINAND_HWECC
	bool "Use SPINAND Hardware ECC"
	depends on MTD_SPINAND
	help
	  Hardware ECC.
	  Enables Hardware ECC support for SPI NAND.

config MTD_SPINOR
	tristate "SPINOR Device Support"
	depends on (NVT_NT96660 || MACH_NVT_NA51000) && (!MTD_SPINAND)
	help
	  This enables support for accessing SPI NOR flash
	  devices.
	  If you have SPI NOR chip say yes.

	  If unsure, say no here.

config MTD_EXTERNAL_FLASH_TABLE
	tristate "Using external flash table"
	depends on MTD_SPINOR
	help
	  This enables support for using external flash table
	  If you have requrired external table say yes.

	  If unsure, say no here.
```

## linux-supplement/net/synopsys/Kconfig
```kconfig
#
# Synopsys network device configuration
#

config SYNOPSYS_DWC_ETH_QOS
        tristate "Sypnopsys DWC Ethernet QOS v4.21a support"
        select PHYLIB
        select CRC32
        select MII
	select INET_LRO
        depends on HAS_DMA
        ---help---
          This driver supports the DWC Ethernet QoS from Synopsys
```
